## sdkconfig.defaults
```kconfig
CONFIG_IDF_TARGET="esp32"

CONFIG_COMPILER_OPTIMIZATION_PERF=y
# CONFIG_COMPILER_OPTIMIZATION_SIZE=y

CONFIG_ESPTOOLPY_FLASHSIZE_4MB=y
CONFIG_ESPTOOLPY_FLASHSIZE="4MB"

CONFIG_FREERTOS_HZ=1000
# CONFIG_ESP_SYSTEM_PANIC_PRINT_HALT=y

# Bluetooth:
CONFIG_BT_ENABLED=y
# CONFIG_BTDM_CTRL_MODE_BTDM=y
# CONFIG_BTDM_CTRL_HCI_MODE_VHCI=y
CONFIG_BT_NIMBLE_ENABLED=y
# CONFIG_BT_BLE_ENABLED=y
# CONFIG_BT_HID_ENABLED=y
# CONFIG_BT_HID_DEVICE_ENABLED=y
CONFIG_BT_NIMBLE_LOG_LEVEL_WARNING=y
CONFIG_BT_NIMBLE_LOG_LEVEL_INFO=n

# MODEM SLEEP Options
CONFIG_BTDM_CTRL_MODEM_SLEEP=y
CONFIG_BTDM_CTRL_MODEM_SLEEP_MODE_ORIG=y
# Bluetooth low power clock
CONFIG_BTDM_CTRL_LPCLK_SEL_EXT_32K_XTAL=y

# RTC clock source
CONFIG_ESP32_RTC_CLK_SRC_EXT_CRYS=y

# Enable support for power management
CONFIG_PM_ENABLE=y
# Enable tickless idle mode
CONFIG_FREERTOS_USE_TICKLESS_IDLE=y
# Set the tick rate at which FreeRTOS does pre-emptive context switching.
CONFIG_FREERTOS_HZ=1000
# Minimum number of ticks to enter sleep mode for
CONFIG_FREERTOS_IDLE_TIME_BEFORE_SLEEP=3

# Common ESP-related
#
CONFIG_ESP_SYSTEM_EVENT_TASK_STACK_SIZE=4096
CONFIG_ESP_MAIN_TASK_STACK_SIZE=8192

#
# Partition Table
#
CONFIG_PARTITION_TABLE_CUSTOM=y
CONFIG_PARTITION_TABLE_CUSTOM_FILENAME="partitions.csv"
```
